## Documentation/devicetree/bindings/input/touchscreen/st,stmfts-fts5cu56a.yaml
```yaml
# SPDX-License-Identifier: GPL-2.0-only OR BSD-2-Clause
%YAML 1.2
---
$id: http://devicetree.org/schemas/input/touchscreen/st,stmfts-fts5cu56a.yaml#
$schema: http://devicetree.org/meta-schemas/core.yaml#

title: STMicroelectronics FTS5CU56A touchscreen controller

maintainers:
  - Miroslav Mráz <miroslav.mraz@techmania.cz>

description:
  The FTS5CU56A is an I2C capacitive multi-touch controller found on the
  Samsung Galaxy A52 (a52q) and similar devices.

allOf:
  - $ref: touchscreen.yaml#

properties:
  compatible:
    const: st,stmfts_fts5cu56a

  reg:
    maxItems: 1

  interrupts:
    maxItems: 1

  vdd-supply:
    description: Digital power supply (1.8V).

  avdd-supply:
    description: Analog power supply (3.0V).

required:
  - compatible
  - reg
  - interrupts
  - vdd-supply
  - avdd-supply

unevaluatedProperties: false

examples:
  - |
    #include <dt-bindings/interrupt-controller/irq.h>
    i2c {
        #address-cells = <1>;
        #size-cells = <0>;

        touchscreen@49 {
            compatible = "st,stmfts_fts5cu56a";
            reg = <0x49>;
            interrupt-parent = <&tlmm>;
            interrupts = <9 IRQ_TYPE_LEVEL_LOW>;
            vdd-supply = <&vreg_l10a_1p8>;
            avdd-supply = <&vreg_l7c_3p0>;
        };
    };
...
```

## Documentation/devicetree/bindings/leds/awinic,aw9120.yaml
```yaml
# SPDX-License-Identifier: (GPL-2.0-only OR BSD-2-Clause)
%YAML 1.2
---
$id: http://devicetree.org/schemas/leds/awinic,aw9120.yaml#
$schema: http://devicetree.org/meta-schemas/core.yaml#

title: Awinic AW9120 20-channel LED controller

maintainers:
  - Miroslav Mraz <miroslav.mraz@techmania.cz>

description:
  The AW9120 is an I2C constant-current LED controller with 20 individually
  controlled outputs (0-19). Outputs wired together as an RGB LED are described
  by a multi-led node whose led sub-nodes select the colour component; remaining
  outputs are described by individual led nodes. In both cases the unit address
  of a (sub-)node that maps to an output is that output's index.

properties:
  compatible:
    const: awinic,aw9120

  reg:
    maxItems: 1

  "#address-cells":
    const: 1

  "#size-cells":
    const: 0

  enable-gpios:
    description: GPIO connected to the PDN (power-down) pin.
    maxItems: 1

  vcc-supply:
    description: Regulator supplying the controller.

patternProperties:
  "^multi-led@[0-9a-f]+$":
    type: object
    $ref: leds-class-multicolor.yaml#
    unevaluatedProperties: false

    properties:
      reg:
        description: Lowest output index of the RGB group.
        minimum: 0
        maximum: 19

      "#address-cells":
        const: 1

      "#size-cells":
        const: 0

    patternProperties:
      "^led@[0-9a-f]+$":
        type: object
        $ref: common.yaml#
        unevaluatedProperties: false

        properties:
          reg:
            description: Index of the LED output.
            minimum: 0
            maximum: 19

        required:
          - reg
          - color

    required:
      - reg
      - color
      - "#address-cells"
      - "#size-cells"

  "^led@[0-9a-f]+$":
    type: object
    $ref: common.yaml#
    unevaluatedProperties: false

    properties:
      reg:
        description: Index of the LED output.
        minimum: 0
        maximum: 19

    required:
      - reg

required:
  - compatible
  - reg
  - "#address-cells"
  - "#size-cells"

additionalProperties: false

examples:
  - |
    #include <dt-bindings/gpio/gpio.h>
    #include <dt-bindings/leds/common.h>

    i2c {
        #address-cells = <1>;
        #size-cells = <0>;

        led-controller@2c {
            compatible = "awinic,aw9120";
            reg = <0x2c>;
            #address-cells = <1>;
            #size-cells = <0>;
            enable-gpios = <&pio 245 GPIO_ACTIVE_HIGH>;

            multi-led@0 {
                reg = <0>;
                color = <LED_COLOR_ID_RGB>;
                function = LED_FUNCTION_INDICATOR;
                #address-cells = <1>;
                #size-cells = <0>;

                led@0 {
                    reg = <0>;
                    color = <LED_COLOR_ID_RED>;
                };

                led@1 {
                    reg = <1>;
                    color = <LED_COLOR_ID_GREEN>;
                };

                led@2 {
                    reg = <2>;
                    color = <LED_COLOR_ID_BLUE>;
                };
            };

            led@3 {
                reg = <3>;
                color = <LED_COLOR_ID_WHITE>;
                function = LED_FUNCTION_STATUS;
            };
        };
    };

...
```

## Documentation/devicetree/bindings/media/i2c/onnn,lc898219xi.yaml
```yaml
# SPDX-License-Identifier: GPL-2.0-only OR BSD-2-Clause
%YAML 1.2
---
$id: http://devicetree.org/schemas/media/i2c/onnn,lc898219xi.yaml#
$schema: http://devicetree.org/meta-schemas/core.yaml#

title: ON Semiconductor LC898219XI Voice Coil Motor (VCM) Lens

maintainers:
  - Vasiliy Doylov <nekocwd@mainlining.org>

description:
  The LC898219XI is a camera lens voice coil motor driver with an internal
  DAC, controlled over I2C. It is used to move the focus lens in a camera
  module.

properties:
  compatible:
    const: onnn,lc898219xi

  reg:
    maxItems: 1

  vdd-supply:
    description: Digital core voltage supply.

  vio-supply:
    description: I/O voltage supply.

  vana-supply:
    description: Motor (analog) voltage supply.

required:
  - compatible
  - reg
  - vdd-supply
  - vio-supply
  - vana-supply

additionalProperties: false

examples:
  - |
    i2c {
        #address-cells = <1>;
        #size-cells = <0>;

        camera-lens@72 {
            compatible = "onnn,lc898219xi";
            reg = <0x72>;
            vdd-supply = <&camera_ldo>;
            vio-supply = <&slg51000_ldo7>;
            vana-supply = <&slg51000_ldo3>;
        };
    };
```

## Documentation/devicetree/bindings/media/i2c/samsung,ois-mcu.yaml
```yaml
# SPDX-License-Identifier: (GPL-2.0-only OR BSD-2-Clause)
%YAML 1.2
---
$id: http://devicetree.org/schemas/media/i2c/samsung,ois-mcu.yaml#
$schema: http://devicetree.org/meta-schemas/core.yaml#

title: Samsung camera OIS MCU

maintainers:
  - Miroslav Mráz <miroslav.mraz@techmania.cz>

description:
  The Samsung camera optical image stabilisation (OIS) MCU is an STM32G
  microcontroller running Samsung OIS firmware, controlled over I2C. It
  stabilises a main camera module and has no image data path of its own.
  It is powered through runtime PM as a supplier of the image sensor it
  serves, so that streaming the sensor resumes and initialises the OIS.

properties:
  compatible:
    const: samsung,ois-mcu

  reg:
    maxItems: 1

  vdd-supply:
    description: Motor drive supply.

  vio-supply:
    description: I/O and logic supply.

  reset-gpios:
    description: MCU NRST reset line, active low.
    maxItems: 1

  boot0-gpios:
    description:
      MCU BOOT0 line. Held low to boot from the main flash rather than the
      ST system bootloader.
    maxItems: 1

  samsung,image-sensor:
    $ref: /schemas/types.yaml#/definitions/phandle
    description:
      Phandle to the image sensor this MCU stabilises. The OIS is added as a
      runtime-PM supplier of that sensor, so streaming the sensor powers and
      initialises the OIS.

  nvmem-cells:
    items:
      - description: OIS calibration valid mark from the module EEPROM.
      - description: Wide XGG/YGG gyro gain calibration from the module EEPROM.

  nvmem-cell-names:
    items:
      - const: cal-mark
      - const: xygg

required:
  - compatible
  - reg
  - vdd-supply
  - vio-supply
  - reset-gpios
  - boot0-gpios

additionalProperties: false

examples:
  - |
    #include <dt-bindings/gpio/gpio.h>

    i2c {
        #address-cells = <1>;
        #size-cells = <0>;

        ois@62 {
            compatible = "samsung,ois-mcu";
            reg = <0x62>;
            vdd-supply = <&vreg_cam_l7>;
            vio-supply = <&vreg_cam_l3>;
            reset-gpios = <&tlmm 32 GPIO_ACTIVE_LOW>;
            boot0-gpios = <&tlmm 43 GPIO_ACTIVE_HIGH>;
            samsung,image-sensor = <&main_sensor>;
        };
    };

...
```

## Documentation/devicetree/bindings/media/i2c/samsung,s5k3l6xx.yaml
```yaml
# SPDX-License-Identifier: (GPL-2.0-only OR BSD-2-Clause)
%YAML 1.2
---
$id: http://devicetree.org/schemas/media/i2c/samsung,s5k3l6xx.yaml#
$schema: http://devicetree.org/meta-schemas/core.yaml#

title: Samsung S5K3L6XX Image Sensor

maintainers:
  - Miroslav Mráz <miroslav.mraz@techmania.cz>

description:
  The Samsung S5K3L6XX is a 1/3.1-inch 13MP CMOS active pixel digital image
  sensor with a Bayer colour filter array. It is programmable through an I2C
  interface and outputs image data over a 4-lane MIPI CSI-2 D-PHY interface.

allOf:
  - $ref: /schemas/media/video-interface-devices.yaml#

properties:
  compatible:
    const: samsung,s5k3l6xx

  reg:
    maxItems: 1

  clocks:
    description: MCLK supply clock.
    maxItems: 1

  clock-names:
    items:
      - const: mclk

  clock-frequency:
    description: MCLK frequency in Hz.
    minimum: 6000000
    maximum: 32000000

  rstn-gpios:
    description: Active low GPIO connected to the RESETN pad of the sensor.
    maxItems: 1

  vdda-supply:
    description: Analogue voltage supply, 2.8 volts.

  vddd-supply:
    description: Digital core voltage supply, 1.05 volts.

  vddio-supply:
    description: Digital I/O voltage supply, 1.8 volts.

  port:
    $ref: /schemas/graph.yaml#/$defs/port-base
    additionalProperties: false

    properties:
      endpoint:
        $ref: /schemas/media/video-interfaces.yaml#
        unevaluatedProperties: false

        properties:
          data-lanes:
            items:
              - const: 1
              - const: 2
              - const: 3
              - const: 4

        required:
          - data-lanes
          - link-frequencies

required:
  - compatible
  - reg
  - clocks
  - clock-names
  - port

unevaluatedProperties: false

examples:
  - |
    #include <dt-bindings/gpio/gpio.h>

    i2c {
        #address-cells = <1>;
        #size-cells = <0>;

        camera@2d {
            compatible = "samsung,s5k3l6xx";
            reg = <0x2d>;
            clocks = <&camera_mclk 0>;
            clock-names = "mclk";
            clock-frequency = <19200000>;
            rstn-gpios = <&tlmm 66 GPIO_ACTIVE_LOW>;
            vdda-supply = <&vreg_2p8>;
            vddd-supply = <&vreg_1p05>;
            vddio-supply = <&vreg_1p8>;

            port {
                endpoint {
                    remote-endpoint = <&csiphy3_ep>;
                    data-lanes = <1 2 3 4>;
                    link-frequencies = /bits/ 64 <595200000>;
                };
            };
        };
    };
...
```

## Documentation/devicetree/bindings/media/i2c/samsung,s5kgw1p.yaml
```yaml
# SPDX-License-Identifier: (GPL-2.0-only OR BSD-2-Clause)
%YAML 1.2
---
$id: http://devicetree.org/schemas/media/i2c/samsung,s5kgw1p.yaml#
$schema: http://devicetree.org/meta-schemas/core.yaml#

title: Samsung S5KGW1P Image Sensor

maintainers:
  - Miroslav Mráz <miroslav.mraz@techmania.cz>

description:
  The Samsung S5KGW1P (ISOCELL GW1) is a 1/1.72-inch 64MP CMOS active pixel
  digital image sensor with a Tetracell colour filter array. It is programmable
  through an I2C interface and outputs image data over a 3-trio MIPI CSI-2
  C-PHY interface.

allOf:
  - $ref: /schemas/media/video-interface-devices.yaml#

properties:
  compatible:
    const: samsung,s5kgw1p

  reg:
    maxItems: 1

  clocks:
    description: MCLK supply clock.
    maxItems: 1

  clock-names:
    items:
      - const: mclk

  reset-gpios:
    description: Active low GPIO connected to the RESET pad of the sensor.
    maxItems: 1

  vana-supply:
    description: Analogue voltage supply, 2.8 volts.

  vdig-supply:
    description: Digital core voltage supply, 1.05 volts.

  vio-supply:
    description: Digital I/O voltage supply, 1.8 volts.

  vaf-supply:
    description: Autofocus actuator voltage supply, 2.8 volts.

  vcustom-supply:
    description: Sensor-specific auxiliary voltage supply.

  port:
    $ref: /schemas/graph.yaml#/$defs/port-base
    additionalProperties: false

    properties:
      endpoint:
        $ref: /schemas/media/video-interfaces.yaml#
        unevaluatedProperties: false

        properties:
          bus-type:
            const: 1

          data-lanes:
            items:
              - const: 1
              - const: 2
              - const: 3

        required:
          - bus-type
          - data-lanes
          - link-frequencies

required:
  - compatible
  - reg
  - clocks
  - clock-names
  - port

unevaluatedProperties: false

examples:
  - |
    #include <dt-bindings/gpio/gpio.h>

    i2c {
        #address-cells = <1>;
        #size-cells = <0>;

        camera@2d {
            compatible = "samsung,s5kgw1p";
            reg = <0x2d>;
            clocks = <&camera_mclk 0>;
            clock-names = "mclk";
            reset-gpios = <&tlmm 21 GPIO_ACTIVE_LOW>;
            vana-supply = <&vreg_2p8>;
            vdig-supply = <&vreg_1p05>;
            vio-supply = <&vreg_1p8>;
            vaf-supply = <&vreg_af_2p8>;
            vcustom-supply = <&vreg_custom>;

            port {
                endpoint {
                    remote-endpoint = <&csiphy0_ep>;
                    bus-type = <1>;
                    data-lanes = <1 2 3>;
                    link-frequencies = /bits/ 64 <1000000000>;
                };
            };
        };
    };
...
```
