## Documentation/devicetree/bindings/media/qcom,sm7150-venus.yaml
```yaml
# SPDX-License-Identifier: (GPL-2.0 OR BSD-2-Clause)
%YAML 1.2
---
$id: http://devicetree.org/schemas/media/qcom,sm7150-venus.yaml#
$schema: http://devicetree.org/meta-schemas/core.yaml#

title: Qualcomm SM7150 Venus video encode and decode accelerator

maintainers:
  - Miroslav Mráz <mraz.miro@seznam.cz>

description: |
  The Venus IP is a video encode and decode accelerator present
  on Qualcomm platforms

allOf:
  - $ref: qcom,venus-common.yaml#

properties:
  compatible:
    const: qcom,sm7150-venus

  power-domains:
    maxItems: 4

  power-domain-names:
    items:
      - const: venus
      - const: vcodec0
      - const: cvp
      - const: cx

  clocks:
    maxItems: 7

  clock-names:
    items:
      - const: core
      - const: iface
      - const: bus
      - const: vcodec0_core
      - const: vcodec0_bus
      - const: cvp_core
      - const: cvp_bus

  iommus:
    maxItems: 1

  memory-region:
    maxItems: 1

  interconnects:
    maxItems: 2

  interconnect-names:
    items:
      - const: cpu-cfg
      - const: video-mem

  operating-points-v2: true
  opp-table:
    type: object

  video-decoder:
    type: object

    properties:
      compatible:
        const: venus-decoder

    required:
      - compatible

    deprecated: true
    additionalProperties: false

  video-encoder:
    type: object

    properties:
      compatible:
        const: venus-encoder

    required:
      - compatible

    deprecated: true
    additionalProperties: false

required:
  - compatible
  - power-domain-names
  - iommus

unevaluatedProperties: false

examples:
  - |
    #include <dt-bindings/interrupt-controller/arm-gic.h>
    #include <dt-bindings/clock/qcom,sm7150-videocc.h>
    #include <dt-bindings/power/qcom,rpmhpd.h>

    venus: video-codec@aa00000 {
        compatible = "qcom,sm7150-venus";
        reg = <0x0aa00000 0xff000>;
        interrupts = <GIC_SPI 174 IRQ_TYPE_LEVEL_HIGH>;
        power-domains = <&videocc VENUS_GDSC>,
                        <&videocc VCODEC0_GDSC>,
                        <&videocc VCODEC1_GDSC>,
                        <&rpmhpd RPMHPD_CX>;
        power-domain-names = "venus", "vcodec0", "cvp", "cx";
        clocks = <&videocc VIDEOCC_MVSC_CORE_CLK>,
                 <&videocc VIDEOCC_VENUS_AHB_CLK>,
                 <&videocc VIDEOCC_MVSC_CTL_AXI_CLK>,
                 <&videocc VIDEOCC_MVS0_CORE_CLK>,
                 <&videocc VIDEOCC_MVS0_AXI_CLK>,
                 <&videocc VIDEOCC_MVS1_CORE_CLK>,
                 <&videocc VIDEOCC_MVS1_AXI_CLK>;
        clock-names = "core", "iface", "bus",
                      "vcodec0_core", "vcodec0_bus",
                      "cvp_core", "cvp_bus";
        iommus = <&apps_smmu 0x1080 0x60>;
        memory-region = <&venus_mem>;
        operating-points-v2 = <&venus_opp_table>;

        venus_opp_table: opp-table {
            compatible = "operating-points-v2";

            opp-240000000 {
                opp-hz = /bits/ 64 <240000000>;
                required-opps = <&rpmhpd_opp_low_svs>;
            };
        };
    };
```

## Documentation/devicetree/bindings/misc/fpc,fpc1020.yaml
```yaml
# SPDX-License-Identifier: (GPL-2.0-only OR BSD-2-Clause)
%YAML 1.2
---
$id: http://devicetree.org/schemas/misc/fpc,fpc1020.yaml#
$schema: http://devicetree.org/meta-schemas/core.yaml#

title: FPC fingerprint sensor behind a Qualcomm QSEE trustlet

maintainers:
  - Giuseppe Maggio <jertlok@proton.me>

description:
  An FPC1020-family match-on-chip fingerprint sensor whose SPI bus belongs to
  TrustZone, as on the Google Pixel 2 XL. Enrolment and matching run inside a
  vendor trustlet; the operating system owns the sensor's supply, reset and
  interrupt lines, loads the trustlet, and carries commands to it.

properties:
  compatible:
    const: fpc,fpc1020

  firmware-name:
    maxItems: 1
    description:
      The trustlet's .mdt image, relative to the firmware search path. Its
      .bNN segments are expected beside it.

  irq-gpios:
    maxItems: 1
    description:
      The sensor's interrupt line. Its level, not only its edges, is what the
      trustlet's capture sequence waits on.

  reset-gpios:
    maxItems: 1

  vdd-io-supply:
    description: Supply of the sensor's IO.

required:
  - compatible
  - firmware-name
  - irq-gpios
  - reset-gpios
  - vdd-io-supply

additionalProperties: false

examples:
  - |
    #include <dt-bindings/gpio/gpio.h>

    fingerprint {
        compatible = "fpc,fpc1020";
        firmware-name = "qcom/msm8998/taimen/fpctzappfingerprint.mdt";
        irq-gpios = <&tlmm 86 GPIO_ACTIVE_HIGH>;
        reset-gpios = <&tlmm 128 GPIO_ACTIVE_LOW>;
        vdd-io-supply = <&vreg_s4a_1p8>;
    };
```

## Documentation/devicetree/bindings/net/wireless/mediatek,mt6797-wlan.yaml
```yaml
# SPDX-License-Identifier: (GPL-2.0-only OR BSD-2-Clause)
%YAML 1.2
---
$id: http://devicetree.org/schemas/net/wireless/mediatek,mt6797-wlan.yaml#
$schema: http://devicetree.org/meta-schemas/core.yaml#

title: MediaTek MT6797 Wi-Fi AHB host interface

maintainers:
  - Miroslav Mraz <miroslav.mraz@techmania.cz>

description: |
  The AHB SDIO-like host interface of the MT6797 CONSYS Wi-Fi function. The
  CONSYS node powers and initialises the island; this node describes the Wi-Fi
  HIF register window, its interrupt and the AP-DMA clock the HIF DMA path uses.

properties:
  compatible:
    const: mediatek,mt6797-wlan

  reg:
    maxItems: 1

  interrupts:
    maxItems: 1

  clocks:
    maxItems: 1
    description: AP-DMA clock used by the HIF DMA path.

  clock-names:
    const: wifi-dma

required:
  - compatible
  - reg
  - interrupts
  - clocks
  - clock-names

additionalProperties: false

examples:
  - |
    #include <dt-bindings/clock/mt6797-clk.h>
    #include <dt-bindings/interrupt-controller/arm-gic.h>
    #include <dt-bindings/interrupt-controller/irq.h>

    wifi@180f0000 {
        compatible = "mediatek,mt6797-wlan";
        reg = <0x180f0000 0x1100>;
        interrupts = <GIC_SPI 283 IRQ_TYPE_LEVEL_LOW>;
        clocks = <&infrasys CLK_INFRA_AP_DMA>;
        clock-names = "wifi-dma";
    };
```

## Documentation/devicetree/bindings/pinctrl/qcom,sm7150-lpass-lpi-pinctrl.yaml
```yaml
# SPDX-License-Identifier: (GPL-2.0-only OR BSD-2-Clause)
%YAML 1.2
---
$id: http://devicetree.org/schemas/pinctrl/qcom,sm7150-lpass-lpi-pinctrl.yaml#
$schema: http://devicetree.org/meta-schemas/core.yaml#

title: Qualcomm SM7150 SoC LPASS LPI TLMM

maintainers:
  - Miroslav Mráz <mraz.miro@seznam.cz>

description:
  Top Level Mode Multiplexer pin controller in the Low Power Audio SubSystem
  (LPASS) Low Power Island (LPI) of Qualcomm SM7150 SoC.

properties:
  compatible:
    const: qcom,sm7150-lpass-lpi-pinctrl

  reg:
    items:
      - description: LPASS LPI TLMM Control and Status registers

  clocks:
    maxItems: 1

  clock-names:
    items:
      - const: core

patternProperties:
  "-state$":
    oneOf:
      - $ref: "#/$defs/qcom-sm7150-lpass-state"
      - patternProperties:
          "-pins$":
            $ref: "#/$defs/qcom-sm7150-lpass-state"
        additionalProperties: false

$defs:
  qcom-sm7150-lpass-state:
    type: object
    description:
      Pinctrl node's client devices use subnodes for desired pin configuration.
      Client device subnodes use below standard properties.
    $ref: qcom,lpass-lpi-common.yaml#/$defs/qcom-tlmm-state
    unevaluatedProperties: false

    properties:
      pins:
        description:
          List of gpio pins affected by the properties specified in this
          subnode.
        items:
          pattern: "^gpio([0-9]|1[0-9]|2[0-9]|3[0-1])$"

      function:
        enum: [ gpio, audio_ref, cdc_pdm_rx, dmic1_clk, dmic1_data, dmic2_clk,
                dmic2_data, gp_pdm, prim_mclk_a, prim_mclk_b, qca_sb_clk,
                qca_sb_data, qdss_cti, qua_mi2s_data, qua_mi2s_sclk,
                qua_mi2s_ws, sec_mi2s, slimbus_clk, slimbus_data, swr_rx_clk,
                swr_rx_data, swr_tx_clk, swr_tx_data ]
        description:
          Specify the alternative function to be configured for the specified
          pins.

allOf:
  - $ref: qcom,lpass-lpi-common.yaml#

required:
  - compatible
  - reg

unevaluatedProperties: false

examples:
  - |
    lpi_tlmm: pinctrl@62b40000 {
        compatible = "qcom,sm7150-lpass-lpi-pinctrl";
        reg = <0x62b40000 0x20000>;
        gpio-controller;
        #gpio-cells = <2>;
        gpio-ranges = <&lpi_tlmm 0 0 32>;

        tx_swr_active: tx-swr-active-state {
            clk-pins {
                pins = "gpio18";
                function = "swr_tx_clk";
                drive-strength = <2>;
                slew-rate = <1>;
                bias-disable;
            };

            data-pins {
                pins = "gpio19", "gpio20";
                function = "swr_tx_data";
                drive-strength = <2>;
                slew-rate = <1>;
                bias-bus-hold;
            };
        };
    };
```

## Documentation/devicetree/bindings/power/supply/mediatek,mt6351-fuel-gauge.yaml
```yaml
# SPDX-License-Identifier: (GPL-2.0-only OR BSD-2-Clause)
%YAML 1.2
---
$id: http://devicetree.org/schemas/power/supply/mediatek,mt6351-fuel-gauge.yaml#
$schema: http://devicetree.org/meta-schemas/core.yaml#

title: MediaTek MT6351 PMIC fuel gauge

maintainers:
  - Miroslav Mraz <miroslav.mraz@techmania.cz>

description:
  The MT6351 PMIC integrates a hardware fuel-gauge ADC (FGADC) that measures
  the battery current through an external sense resistor. Together with the
  battery voltage read from the PMIC AUXADC it provides battery state-of-charge
  reporting. The fuel gauge is a sub-function of the PMIC and is described as a
  child of the PMIC node.

allOf:
  - $ref: power-supply.yaml#

properties:
  compatible:
    const: mediatek,mt6351-fuel-gauge

  io-channels:
    maxItems: 1
    description:
      AUXADC channel measuring the battery voltage. On power-path designs this
      is the ISENSE channel (battery side of the external charger).

  io-channel-names:
    const: vbat

  shunt-resistor-micro-ohms:
    description:
      Value of the FGADC battery current sense resistor. Includes any gauge
      calibration gain correction.

  monitored-battery:
    description:
      phandle to a simple-battery node providing the ocv-capacity-table,
      internal resistance and constant-charge voltage used to convert the
      current and voltage readings into a state of charge.

  power-supplies: true

required:
  - compatible
  - io-channels
  - io-channel-names
  - shunt-resistor-micro-ohms
  - monitored-battery

unevaluatedProperties: false

examples:
  - |
    #include <dt-bindings/iio/adc/mediatek,mt6351-auxadc.h>

    pmic {
        pmic_adc: adc {
            compatible = "mediatek,mt6351-auxadc";
            #io-channel-cells = <1>;
        };

        fuel-gauge {
            compatible = "mediatek,mt6351-fuel-gauge";
            io-channels = <&pmic_adc MT6351_AUXADC_ISENSE>;
            io-channel-names = "vbat";
            shunt-resistor-micro-ohms = <8696>;
            monitored-battery = <&battery>;
            power-supplies = <&charger>;
        };
    };
...
```

## Documentation/devicetree/bindings/power/supply/qcom,pm6150-qg.yaml
```yaml
# SPDX-License-Identifier: (GPL-2.0-only OR BSD-2-Clause)
%YAML 1.2
---
$id: http://devicetree.org/schemas/power/supply/qcom,pm6150-qg.yaml#
$schema: http://devicetree.org/meta-schemas/core.yaml#

title: Qualcomm PMIC QGauge (QG) fuel gauge

maintainers:
  - Danila Tikhonov <danila@jiaxyga.com>

description:
  QGauge is a battery fuel-gauge hardware block found in some Qualcomm PMICs
  such as the PM6150. It samples pack voltage and current and stores its
  learned state in a companion SDAM. The driver derives capacity from the
  monitored-battery voltage range and reports charge state from the wired
  charger power supply.

allOf:
  - $ref: power-supply.yaml#

properties:
  compatible:
    const: qcom,pm6150-qg

  reg:
    maxItems: 1

  io-channels:
    maxItems: 1

  io-channel-names:
    items:
      - const: batt-therm

  nvmem:
    description: SDAM the fuel gauge keeps its learned state in
    maxItems: 1

  monitored-battery: true

  power-supplies: true

required:
  - compatible
  - reg
  - io-channels
  - io-channel-names
  - nvmem
  - monitored-battery

additionalProperties: false

examples:
  - |
    #include <dt-bindings/iio/qcom,spmi-vadc.h>
    pmic {
      #address-cells = <1>;
      #size-cells = <0>;

      battery@4800 {
        compatible = "qcom,pm6150-qg";
        reg = <0x4800>;

        io-channels = <&pm6150_adc ADC5_BAT_THERM_100K_PU>;
        io-channel-names = "batt-therm";

        nvmem = <&pm6150_qg_sdam>;

        monitored-battery = <&battery>;
        power-supplies = <&pm6150_charger>;
      };
    };
```

## Documentation/devicetree/bindings/power/supply/siliconmitus,sm5714-charger.yaml
```yaml
# SPDX-License-Identifier: GPL-2.0-only OR BSD-2-Clause
%YAML 1.2
---
$id: http://devicetree.org/schemas/power/supply/siliconmitus,sm5714-charger.yaml#
$schema: http://devicetree.org/meta-schemas/core.yaml#

title: Silicon Mitus SM5714 charger

maintainers:
  - Miroslav Mráz <miroslav.mraz@techmania.cz>

description:
  The SM5714 is a combo PMIC integrating a charger, a fuel gauge and a
  Type-C/USB block. This binding describes the charger block, which is
  exposed on its own I2C address. It controls battery charging, provides
  the USB OTG VBUS boost regulator and a torch LED output.

properties:
  compatible:
    const: siliconmitus,sm5714-charger

  reg:
    maxItems: 1

  siliconmitus,enable-autostop:
    type: boolean
    description:
      Stop charging automatically once the top-off condition is reached.

  siliconmitus,input-current-limit:
    $ref: /schemas/types.yaml#/definitions/uint32
    description: Input (VBUS) current limit in mA.
    minimum: 100
    maximum: 3000

  siliconmitus,charging-current:
    $ref: /schemas/types.yaml#/definitions/uint32
    description: Fast-charging current in mA.
    minimum: 100
    maximum: 3500

  siliconmitus,topoff-current:
    $ref: /schemas/types.yaml#/definitions/uint32
    description: Top-off (charge termination) current in mA.
    minimum: 100
    maximum: 675

  usb-otg-vbus:
    type: object
    $ref: /schemas/regulator/regulator.yaml#
    description: USB OTG VBUS boost regulator provided by the charger.
    unevaluatedProperties: false

required:
  - compatible
  - reg

additionalProperties: false

examples:
  - |
    i2c {
        #address-cells = <1>;
        #size-cells = <0>;

        charger@49 {
            compatible = "siliconmitus,sm5714-charger";
            reg = <0x49>;

            siliconmitus,enable-autostop;
            siliconmitus,input-current-limit = <1300>;
            siliconmitus,charging-current = <1300>;
            siliconmitus,topoff-current = <225>;

            usb-otg-vbus {
                regulator-name = "usb_otg_vbus";
            };
        };
    };
...
```
