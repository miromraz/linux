## Documentation/devicetree/bindings/media/i2c/sony,imx363.yaml
```yaml
# SPDX-License-Identifier: (GPL-2.0-only OR BSD-2-Clause)
%YAML 1.2
---
$id: http://devicetree.org/schemas/media/i2c/sony,imx363.yaml#
$schema: http://devicetree.org/meta-schemas/core.yaml#

title: Sony IMX363 1/2.55-Inch 12.3MP CMOS Digital Image Sensor

maintainers:
  - Miroslav Mráz <mraz.miro@seznam.cz>

description: |
  The Sony IMX363 is a 1/2.55-inch CMOS active pixel digital image sensor with
  an active pixel array size of 4032H x 3024V. It is programmable through an
  I2C interface. Image data is sent through MIPI CSI-2, over 2 or 4 data lanes.

allOf:
  - $ref: /schemas/media/video-interface-devices.yaml#

properties:
  compatible:
    const: sony,imx363

  reg:
    maxItems: 1

  clocks:
    description: Reference to the INCK (xclk) clock.
    maxItems: 1

  clock-frequency:
    description: Frequency of the INCK clock in Hz.

  reset-gpios:
    description: Reference to the GPIO connected to the XCLR (reset) pin.
    maxItems: 1

  vana-supply:
    description: Analog voltage (VANA) supply, 2.8 V.

  vdig-supply:
    description: Digital core voltage (VDIG) supply, 1.2 V.

  vif-supply:
    description: Interface voltage (VIF) supply, 1.8 V.

  lens-focus: true

  port:
    $ref: /schemas/graph.yaml#/$defs/port-base
    description: Video output port.

    properties:
      endpoint:
        $ref: /schemas/media/video-interfaces.yaml#
        unevaluatedProperties: false

        properties:
          data-lanes:
            anyOf:
              - items:
                  - const: 1
                  - const: 2
              - items:
                  - const: 1
                  - const: 2
                  - const: 3
                  - const: 4

          link-frequencies: true

        required:
          - data-lanes
          - link-frequencies

    additionalProperties: false

required:
  - compatible
  - reg
  - clocks
  - vana-supply
  - vdig-supply
  - vif-supply
  - port

unevaluatedProperties: false

examples:
  - |
    #include <dt-bindings/gpio/gpio.h>

    i2c {
        #address-cells = <1>;
        #size-cells = <0>;

        camera@1a {
            compatible = "sony,imx363";
            reg = <0x1a>;

            clocks = <&camcc 0>;
            assigned-clocks = <&camcc 0>;
            assigned-clock-rates = <24000000>;
            clock-frequency = <24000000>;

            reset-gpios = <&tlmm 43 GPIO_ACTIVE_LOW>;

            vana-supply = <&slg51000_ldo3>;
            vdig-supply = <&slg51000_ldo6>;
            vif-supply = <&slg51000_ldo7>;

            lens-focus = <&rear_cam_actuator>;

            orientation = <1>;
            rotation = <270>;

            port {
                imx363_ep: endpoint {
                    data-lanes = <1 2 3 4>;
                    link-frequencies = /bits/ 64 <636000000>;
                    remote-endpoint = <&csiphy0_ep>;
                };
            };
        };
    };
```

## Documentation/devicetree/bindings/media/i2c/sony,imx616.yaml
```yaml
# SPDX-License-Identifier: (GPL-2.0-only OR BSD-2-Clause)
%YAML 1.2
---
$id: http://devicetree.org/schemas/media/i2c/sony,imx616.yaml#
$schema: http://devicetree.org/meta-schemas/core.yaml#

title: Sony IMX616 Image Sensor

maintainers:
  - Miroslav Mráz <miroslav.mraz@techmania.cz>

description:
  The Sony IMX616 is a 1/2.8-inch 32MP CMOS active pixel digital image sensor
  with a Quad Bayer colour filter array. It is programmable through an I2C
  interface and outputs image data over a 4-lane MIPI CSI-2 D-PHY interface.

allOf:
  - $ref: /schemas/media/video-interface-devices.yaml#

properties:
  compatible:
    const: sony,imx616

  reg:
    maxItems: 1

  clocks:
    description: MCLK supply clock.
    maxItems: 1

  clock-names:
    items:
      - const: mclk

  reset-gpios:
    description: Active low GPIO connected to the XCLR reset pad of the sensor.
    maxItems: 1

  vana-supply:
    description: Analogue voltage supply, 2.8 volts.

  vdig-supply:
    description: Digital core voltage supply, 1.1 volts.

  vio-supply:
    description: Digital I/O voltage supply, 1.8 volts.

  port:
    $ref: /schemas/graph.yaml#/$defs/port-base
    additionalProperties: false

    properties:
      endpoint:
        $ref: /schemas/media/video-interfaces.yaml#
        unevaluatedProperties: false

        properties:
          data-lanes:
            items:
              - const: 1
              - const: 2
              - const: 3
              - const: 4

        required:
          - data-lanes
          - link-frequencies

required:
  - compatible
  - reg
  - clocks
  - clock-names
  - port

unevaluatedProperties: false

examples:
  - |
    #include <dt-bindings/gpio/gpio.h>

    i2c {
        #address-cells = <1>;
        #size-cells = <0>;

        camera@1a {
            compatible = "sony,imx616";
            reg = <0x1a>;
            clocks = <&camera_mclk 0>;
            clock-names = "mclk";
            reset-gpios = <&tlmm 92 GPIO_ACTIVE_LOW>;
            vana-supply = <&vreg_2p8>;
            vdig-supply = <&vreg_1p1>;
            vio-supply = <&vreg_1p8>;

            port {
                endpoint {
                    remote-endpoint = <&csiphy2_ep>;
                    data-lanes = <1 2 3 4>;
                    link-frequencies = /bits/ 64 <516000000>;
                };
            };
        };
    };
...
```
