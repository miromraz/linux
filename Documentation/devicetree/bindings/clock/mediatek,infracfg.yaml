## Documentation/devicetree/bindings/power/supply/siliconmitus,sm5714-fg.yaml
```yaml
# SPDX-License-Identifier: GPL-2.0-only OR BSD-2-Clause
%YAML 1.2
---
$id: http://devicetree.org/schemas/power/supply/siliconmitus,sm5714-fg.yaml#
$schema: http://devicetree.org/meta-schemas/core.yaml#

title: Silicon Mitus SM5714 fuel gauge

maintainers:
  - Miroslav Mráz <miroslav.mraz@techmania.cz>

description:
  The SM5714 is a combo PMIC integrating a charger, a fuel gauge and a
  Type-C/USB block. This binding describes the fuel gauge block, which is
  exposed on its own I2C address and reports battery voltage, current,
  temperature and state of charge.

properties:
  compatible:
    const: siliconmitus,sm5714-fg

  reg:
    maxItems: 1

required:
  - compatible
  - reg

additionalProperties: false

examples:
  - |
    i2c {
        #address-cells = <1>;
        #size-cells = <0>;

        fuel-gauge@71 {
            compatible = "siliconmitus,sm5714-fg";
            reg = <0x71>;
        };
    };
...
```

## Documentation/devicetree/bindings/regulator/mediatek,mt6797-cpu-sram.yaml
```yaml
# SPDX-License-Identifier: (GPL-2.0-only OR BSD-2-Clause)
%YAML 1.2
---
$id: http://devicetree.org/schemas/regulator/mediatek,mt6797-cpu-sram.yaml#
$schema: http://devicetree.org/meta-schemas/core.yaml#

title: MediaTek MT6797 CPU SRAM LDO regulator

maintainers:
  - Miroslav Mraz <miroslav.mraz@techmania.cz>

description:
  The MT6797 feeds the SRAM of its Cortex-A53 clusters and the CCI from a bank
  of on-SoC LDOs in the always-on infracfg block. They form a single Vsram
  rail that must track the DA9214 Vproc rail during frequency changes, so it is
  used as the sram/mem supply of the CPU and CCI frequency drivers. The LDO
  registers live in the infracfg block, so the node is a child of the infracfg
  syscon and reaches the registers through the parent regmap.

allOf:
  - $ref: regulator.yaml#

properties:
  compatible:
    const: mediatek,mt6797-cpu-sram

required:
  - compatible

unevaluatedProperties: false

examples:
  - |
    syscon@10001000 {
        compatible = "syscon", "simple-mfd";
        reg = <0x10001000 0x1000>;

        regulator-cpu-sram {
            compatible = "mediatek,mt6797-cpu-sram";
            regulator-name = "vsram-cpu";
            regulator-min-microvolt = <1000000>;
            regulator-max-microvolt = <1200000>;
            regulator-always-on;
        };
    };

...
```
