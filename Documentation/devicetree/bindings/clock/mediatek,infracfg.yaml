## Documentation/devicetree/bindings/clock/mediatek,infracfg.yaml
```yaml
# SPDX-License-Identifier: (GPL-2.0 OR BSD-2-Clause)
%YAML 1.2
---
$id: http://devicetree.org/schemas/clock/mediatek,infracfg.yaml#
$schema: http://devicetree.org/meta-schemas/core.yaml#

title: MediaTek Infrastructure System Configuration Controller

maintainers:
  - Matthias Brugger <matthias.bgg@gmail.com>

description:
  The Mediatek infracfg controller provides various clocks and reset outputs
  to the system. The clock values can be found in <dt-bindings/clock/mt*-clk.h>
  and <dt-bindings/clock/mediatek,mt*-infracfg.h>, and reset values in
  <dt-bindings/reset/mt*-reset.h>, <dt-bindings/reset/mt*-resets.h> and
  <dt-bindings/reset/mediatek,mt*-infracfg.h>.

properties:
  compatible:
    oneOf:
      - items:
          - enum:
              - mediatek,mt2701-infracfg
              - mediatek,mt2712-infracfg
              - mediatek,mt6735-infracfg
              - mediatek,mt6765-infracfg
              - mediatek,mt6795-infracfg
              - mediatek,mt6779-infracfg_ao
              - mediatek,mt6797-infracfg
              - mediatek,mt7622-infracfg
              - mediatek,mt7629-infracfg
              - mediatek,mt7981-infracfg
              - mediatek,mt7986-infracfg
              - mediatek,mt7988-infracfg
              - mediatek,mt8135-infracfg
              - mediatek,mt8167-infracfg
              - mediatek,mt8173-infracfg
              - mediatek,mt8183-infracfg
              - mediatek,mt8516-infracfg
          - const: syscon
          - const: simple-mfd
        minItems: 2
      - items:
          - const: mediatek,mt7623-infracfg
          - const: mediatek,mt2701-infracfg
          - const: syscon

  reg:
    maxItems: 1

  '#clock-cells':
    const: 1

  '#reset-cells':
    const: 1

required:
  - compatible
  - reg
  - '#clock-cells'

allOf:
  - if:
      properties:
        compatible:
          contains:
            enum:
              - mediatek,mt2701-infracfg
              - mediatek,mt2712-infracfg
              - mediatek,mt6795-infracfg
              - mediatek,mt6797-infracfg
              - mediatek,mt7622-infracfg
              - mediatek,mt7986-infracfg
              - mediatek,mt8135-infracfg
              - mediatek,mt8173-infracfg
              - mediatek,mt8183-infracfg
    then:
      required:
        - '#reset-cells'

  # The MT6797 infracfg block also hosts the on-SoC CPU SRAM LDO regulator:
  # its registers live in this block, so it is described as a child node.
  # No other infracfg variant has it.
  - if:
      properties:
        compatible:
          contains:
            const: mediatek,mt6797-infracfg
    then:
      patternProperties:
        "^regulator-":
          $ref: /schemas/regulator/mediatek,mt6797-cpu-sram.yaml#
    else:
      patternProperties:
        "^regulator-": false

unevaluatedProperties: false

examples:
  - |
    infracfg: clock-controller@10001000 {
        compatible = "mediatek,mt8173-infracfg", "syscon";
        reg = <0x10001000 0x1000>;
        #clock-cells = <1>;
        #reset-cells = <1>;
    };
```

## Documentation/devicetree/bindings/clock/mediatek,mt6797-armpll-b.yaml
```yaml
# SPDX-License-Identifier: (GPL-2.0 OR BSD-2-Clause)
%YAML 1.2
---
$id: http://devicetree.org/schemas/clock/mediatek,mt6797-armpll-b.yaml#
$schema: http://devicetree.org/meta-schemas/core.yaml#

title: MediaTek MT6797 Cortex-A72 cluster ARMPLL

maintainers:
  - Miroslav Mraz <miroslav.mraz@techmania.cz>

description:
  The Cortex-A72 ("big") cluster ARMPLL on the MediaTek MT6797 is part of the
  iDVFS block and, unlike the Cortex-A53 cluster PLLs in the MCUMIXED block, is
  not exposed through a register map. It is controlled through secure-firmware
  SMC calls. This node has no register window; it is a pure SMC-backed clock
  provider so the CPU frequency driver can scale the Cortex-A72 cluster.
  Cell 0 selects the ARMPLL itself, cell 1 the CPU clock mux (clk26m / ARMPLL).

properties:
  compatible:
    const: mediatek,mt6797-armpll-b

  clocks:
    items:
      - description: 26 MHz crystal oscillator (clk26m), the intermediate clock

  clock-names:
    items:
      - const: clk26m

  '#clock-cells':
    const: 1

required:
  - compatible
  - clocks
  - clock-names
  - '#clock-cells'

additionalProperties: false

examples:
  - |
    clock-controller {
        compatible = "mediatek,mt6797-armpll-b";
        clocks = <&clk26m>;
        clock-names = "clk26m";
        #clock-cells = <1>;
    };
```

## Documentation/devicetree/bindings/clock/mediatek,mt6797-mcumixed.yaml
```yaml
# SPDX-License-Identifier: (GPL-2.0 OR BSD-2-Clause)
%YAML 1.2
---
$id: http://devicetree.org/schemas/clock/mediatek,mt6797-mcumixed.yaml#
$schema: http://devicetree.org/meta-schemas/core.yaml#

title: MediaTek MT6797 MCUMIXED clock controller

maintainers:
  - Miroslav Mraz <miroslav.mraz@techmania.cz>

description:
  The MCUMIXED block on the MediaTek MT6797 provides the per-cluster CPU
  PLLs (ARMPLL for the little and big Cortex-A53 clusters and the CCI PLL)
  together with the muxes that select each cluster's clock source between
  the 26 MHz oscillator and its ARMPLL.

  The Cortex-A72 ("big") cluster ARMPLL is also exposed here, even though it
  is not in the MCUMIXED register map (it lives inside the iDVFS block and is
  reachable only through secure-firmware SMC calls). Its clock mux, however,
  is the B-cluster field of the same shared ARMPLLDIV register this block
  owns, so modelling both in one controller keeps the read-modify-write of
  that register serialised with the Cortex-A53 muxes and needs no extra reg
  or phandle.

  Scaling the Cortex-A72 ARMPLL therefore depends on the platform secure
  firmware (ARM Trusted Firmware) implementing the MediaTek iDVFS SIP
  calls. The set-frequency call is MTK_SIP_SMC_CMD(0x3B8) (the vendor
  BigiDVFSPllSetFreq, frequency in MHz); there is no reliable read-back SIP,
  so the programmed rate is not recoverable from firmware once set. On an
  MT6797 whose firmware does not provide these calls the A72 ARMPLL cannot
  be driven; the register-mapped Cortex-A53 and CCI clocks do not need any
  firmware support.

  The clock indices are defined in
  include/dt-bindings/clock/mt6797-clk.h.

properties:
  compatible:
    const: mediatek,mt6797-mcumixed

  reg:
    maxItems: 1

  clocks:
    items:
      - description: 26 MHz crystal oscillator (clk26m)

  clock-names:
    items:
      - const: clk26m

  '#clock-cells':
    const: 1

required:
  - compatible
  - reg
  - clocks
  - clock-names
  - '#clock-cells'

additionalProperties: false

examples:
  - |
    clock-controller@1001a000 {
        compatible = "mediatek,mt6797-mcumixed";
        reg = <0x1001a000 0x1000>;
        clocks = <&clk26m>;
        clock-names = "clk26m";
        #clock-cells = <1>;
    };
```

## Documentation/devicetree/bindings/display/panel/planet,gemini-pda-nt36672.yaml
```yaml
# SPDX-License-Identifier: GPL-2.0-only OR BSD-2-Clause
%YAML 1.2
---
$id: http://devicetree.org/schemas/display/panel/planet,gemini-pda-nt36672.yaml#
$schema: http://devicetree.org/meta-schemas/core.yaml#

title: Planet Gemini PDA NT36672 DSI Panel

maintainers:
  - Julien Etienne <julien.etienne@gmail.com>

allOf:
  - $ref: panel-common.yaml#

properties:
  compatible:
    const: planet,gemini-pda-nt36672

  reg:
    maxItems: 1
    description: DSI virtual channel

  avdd-supply:
    description: Positive analog panel supply (bias OUTP rail)

  avee-supply:
    description: Negative analog panel supply (bias OUTN rail)

  reset-gpios: true
  backlight: true
  port: true

required:
  - compatible
  - reg
  - avdd-supply
  - avee-supply
  - reset-gpios
  - port

additionalProperties: false

examples:
  - |
    #include <dt-bindings/gpio/gpio.h>

    dsi {
        #address-cells = <1>;
        #size-cells = <0>;

        panel@0 {
            compatible = "planet,gemini-pda-nt36672";
            reg = <0>;
            reset-gpios = <&pio 180 GPIO_ACTIVE_HIGH>;
            avdd-supply = <&reg_lcd_bias_outp>;
            avee-supply = <&reg_lcd_bias_outn>;
            backlight = <&backlight>;

            port {
                panel_in: endpoint {
                    remote-endpoint = <&dsi0_out_ep>;
                };
            };
        };
    };
```

## Documentation/devicetree/bindings/display/panel/samsung,s6e3fc3.yaml
```yaml
# SPDX-License-Identifier: GPL-2.0-only OR BSD-2-Clause
%YAML 1.2
---
$id: http://devicetree.org/schemas/display/panel/samsung,s6e3fc3.yaml#
$schema: http://devicetree.org/meta-schemas/core.yaml#

title: Samsung S6E3FC3 AMOLED DDIC

maintainers:
  - Miroslav Mráz <miroslav.mraz@techmania.cz>

description:
  The S6E3FC3 is a display driver IC that drives a command/video mode AMOLED
  panel over MIPI DSI.

allOf:
  - $ref: panel-common.yaml#

properties:
  compatible:
    items:
      - enum:
            # Samsung 6.5 inch, 1080x2400 FHD+ panel
          - samsung,s6e3fc3-ams646yd04
      - const: samsung,s6e3fc3

  reg:
    maxItems: 1

  vci-supply:
    description: VCI regulator

  vddio-supply:
    description: VDDIO regulator

required:
  - compatible
  - reg
  - reset-gpios
  - vci-supply
  - vddio-supply
  - port

unevaluatedProperties: false

examples:
  - |
    #include <dt-bindings/gpio/gpio.h>

    dsi {
        #address-cells = <1>;
        #size-cells = <0>;

        panel@0 {
            compatible = "samsung,s6e3fc3-ams646yd04", "samsung,s6e3fc3";
            reg = <0>;

            vddio-supply = <&vreg_l13a_1p8>;
            vci-supply = <&vreg_l18a_3p0>;

            reset-gpios = <&tlmm 8 GPIO_ACTIVE_LOW>;

            port {
                panel_in: endpoint {
                    remote-endpoint = <&mdss_dsi0_out>;
                };
            };
        };
    };
...
```

## Documentation/devicetree/bindings/input/ti,drv2624.yaml
```yaml
# SPDX-License-Identifier: (GPL-2.0-only OR BSD-2-Clause)
%YAML 1.2
---
$id: http://devicetree.org/schemas/input/ti,drv2624.yaml#
$schema: http://devicetree.org/meta-schemas/core.yaml#

title: Texas Instruments DRV2624 haptic driver

maintainers:
  - miromraz <mraz.miro@seznam.cz>

description:
  The Texas Instruments DRV2624 is a haptic driver for linear resonant
  actuators (LRAs) and eccentric rotating mass (ERM) motors with an I2C
  control interface, an internal RAM waveform sequencer and a real-time
  playback (RTP) input.

allOf:
  - $ref: /schemas/input/input.yaml#

properties:
  compatible:
    const: ti,drv2624

  reg:
    maxItems: 1

  enable-gpios:
    description: Active-high enable pin. The chip enters ultra-low-power
      shutdown when this pin is deasserted.
    maxItems: 1

  interrupts:
    description: Optional. The DRV2624 IRQ pin is asserted on
      diagnostic faults and waveform-completion events.
    maxItems: 1

  vdd-supply:
    description: Power supply to the chip (1.8 V to 3.6 V).

  ti,actuator:
    description: Actuator type connected to the driver.
    enum: [lra, erm]
    default: lra

  vib-rated-mv:
    description: |
      Rated voltage of the actuator, in millivolts, programmed into
      RATED_VOLTAGE (0x1F). Left at the chip reset default when omitted.
    $ref: /schemas/types.yaml#/definitions/uint32
    minimum: 1

  vib-overdrive-mv:
    description: |
      Overdrive clamp voltage of the actuator, in millivolts, programmed
      into OD_CLAMP (0x20). This is the full-scale reference for the
      open-loop drive. Left at the chip reset default when omitted.
    $ref: /schemas/types.yaml#/definitions/uint32
    minimum: 1

  ti,lra-frequency-hz:
    description: Resonant frequency of the LRA, in Hz. Ignored for ERM.
    minimum: 50
    maximum: 500
    default: 205

  ti,open-loop-frequency-hz:
    description: |
      Frequency at which the LRA is driven in open loop, in Hz. Defaults
      to the resonant frequency (ti,lra-frequency-hz) when omitted; set it
      when the actuator is tuned to run off resonance. Ignored for ERM.
    minimum: 50
    maximum: 500

  ti,rtp-open-loop-frequency-hz:
    description: |
      Open-loop drive frequency, in Hz, used for the sustained real-time
      playback (RTP) buzz, which may run at a different frequency than the
      click. Defaults to ti,open-loop-frequency-hz when omitted. Ignored
      for ERM.
    minimum: 50
    maximum: 500

  ti,autocal-comp:
    description: |
      Optional factory autocal compensation. The driver writes these two
      raw calibration bytes to A_CAL_COMP (0x21) and A_CAL_BEMF (0x22) at
      init time. If omitted, the chip's internal autocal default is used.
    $ref: /schemas/types.yaml#/definitions/uint8-array
    minItems: 2
    maxItems: 2

required:
  - compatible
  - reg

additionalProperties: false

examples:
  - |
    #include <dt-bindings/gpio/gpio.h>
    #include <dt-bindings/interrupt-controller/irq.h>

    i2c {
        #address-cells = <1>;
        #size-cells = <0>;

        haptic@5a {
            compatible = "ti,drv2624";
            reg = <0x5a>;
            enable-gpios = <&tlmm 11 GPIO_ACTIVE_HIGH>;
            vdd-supply = <&vreg_haptic>;
            ti,actuator = "lra";
            ti,lra-frequency-hz = <205>;
            vib-rated-mv = <2243>;
            vib-overdrive-mv = <3416>;
        };
    };
```

## Documentation/devicetree/bindings/input/touchscreen/novatek,nt36xxx.yaml
```yaml
# SPDX-License-Identifier: (GPL-2.0-only OR BSD-2-Clause)
%YAML 1.2
---
$id: http://devicetree.org/schemas/input/touchscreen/novatek,nt36xxx.yaml#
$schema: http://devicetree.org/meta-schemas/core.yaml#

title: Novatek NT36772 touchscreen controller

maintainers:
  - Julien Etienne <julien.etienne@gmail.com>

allOf:
  - $ref: touchscreen.yaml#

properties:
  compatible:
    const: novatek,nt36772-ts

  reg:
    const: 0x62

  interrupts:
    maxItems: 1

  reset-gpios:
    maxItems: 1

  vcc-supply:
    description:
      Analog supply. Optional because on some boards (e.g. the Planet Computers
      Gemini PDA) the controller shares always-on panel rails that are not
      individually switchable from this device.

  iovcc-supply:
    description:
      I/O supply. Optional for the same reason as vcc-supply.

required:
  - compatible
  - reg
  - interrupts

unevaluatedProperties: false

examples:
  - |
    #include <dt-bindings/gpio/gpio.h>
    #include <dt-bindings/interrupt-controller/irq.h>
    i2c {
        #address-cells = <1>;
        #size-cells = <0>;

        touchscreen@62 {
            compatible = "novatek,nt36772-ts";
            reg = <0x62>;
            interrupts-extended = <&gpio 85 IRQ_TYPE_EDGE_RISING>;
            reset-gpios = <&gpio 68 GPIO_ACTIVE_HIGH>;
        };
    };
...
```
