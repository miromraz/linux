## Documentation/devicetree/bindings/media/qcom,sm7150-camss.yaml
```yaml
# SPDX-License-Identifier: (GPL-2.0 OR BSD-2-Clause)
%YAML 1.2
---
$id: http://devicetree.org/schemas/media/qcom,sm7150-camss.yaml#
$schema: http://devicetree.org/meta-schemas/core.yaml#

title: Qualcomm SM7150 Camera Subsystem (CAMSS)

maintainers:
  - Miroslav Mráz <mraz.miro@seznam.cz>

description:
  The CAMSS IP is a CSI decoder and ISP present on Qualcomm platforms.  This
  binding describes the CAMSS as found on the SM7150 (Snapdragon 730/730G/732G)
  SoC.

properties:
  compatible:
    const: qcom,sm7150-camss

  reg:
    items:
      - description: Registers for CSIPHY 0
      - description: Registers for CSIPHY 1
      - description: Registers for CSIPHY 2
      - description: Registers for CSIPHY 3
      - description: Registers for VFE (Video Front End) 0
      - description: Registers for VFE 1
      - description: Registers for VFE Lite
      - description: Registers for BPS (Bayer Processing Segment)
      - description: Registers for CAMNOC
      - description: Registers for CPAS CDM
      - description: Registers for CPAS TOP
      - description: Registers for ICP (Imaging Control Processor) CSR
      - description: Registers for ICP QGIC
      - description: Registers for ICP SIERRA
      - description: Registers for IPE (Image Processing Engine) 0
      - description: Registers for IPE 1
      - description: Registers for JPEG DMA
      - description: Registers for JPEG ENC
      - description: Registers for LRME (Low Resolution Motion Estimation)

  reg-names:
    items:
      - const: csiphy0
      - const: csiphy1
      - const: csiphy2
      - const: csiphy3
      - const: vfe0
      - const: vfe1
      - const: vfe_lite
      - const: bps
      - const: camnoc
      - const: cpas_cdm
      - const: cpas_top
      - const: ipc_csr
      - const: ipc_qgic
      - const: ipc_sierra
      - const: ipe0
      - const: ipe1
      - const: jpeg_dma
      - const: jpeg_enc
      - const: lrme

  clocks:
    maxItems: 57

  clock-names:
    items:
      - const: cam_hf_axi
      - const: cam_sf_axi
      - const: camnoc_axi
      - const: camnoc_axi_src
      - const: cpas_ahb
      - const: cphy_rx_src
      - const: csiphy0
      - const: csiphy0_timer
      - const: csiphy0_timer_src
      - const: csiphy1
      - const: csiphy1_timer
      - const: csiphy1_timer_src
      - const: csiphy2
      - const: csiphy2_timer
      - const: csiphy2_timer_src
      - const: csiphy3
      - const: csiphy3_timer
      - const: csiphy3_timer_src
      - const: slow_ahb_src
      - const: vfe0_axi
      - const: vfe0
      - const: vfe0_src
      - const: vfe0_cphy_rx
      - const: vfe0_csid
      - const: vfe0_csid_src
      - const: vfe1_axi
      - const: vfe1
      - const: vfe1_src
      - const: vfe1_cphy_rx
      - const: vfe1_csid
      - const: vfe1_csid_src
      - const: vfe_lite
      - const: vfe_lite_src
      - const: vfe_lite_cphy_rx
      - const: vfe_lite_csid
      - const: vfe_lite_csid_src
      - const: bps
      - const: bps_src
      - const: bps_ahb
      - const: bps_axi
      - const: bps_areg
      - const: icp
      - const: icp_src
      - const: icp_ahb
      - const: ipe0
      - const: ipe0_src
      - const: ipe0_ahb
      - const: ipe0_areg
      - const: ipe0_axi
      - const: ipe1
      - const: ipe1_ahb
      - const: ipe1_areg
      - const: ipe1_axi
      - const: jpeg
      - const: jpeg_src
      - const: lrme
      - const: lrme_src

  interrupts:
    maxItems: 16

  interrupt-names:
    items:
      - const: csiphy0
      - const: csiphy1
      - const: csiphy2
      - const: csiphy3
      - const: csid0
      - const: csid1
      - const: csid_lite
      - const: vfe0
      - const: vfe1
      - const: vfe_lite
      - const: camnoc
      - const: cdm
      - const: icp
      - const: jpeg_dma
      - const: jpeg_enc
      - const: lrme

  interconnects:
    maxItems: 4

  interconnect-names:
    items:
      - const: cam_ahb
      - const: cam_hf_0_mnoc
      - const: cam_sf_0_mnoc
      - const: cam_sf_icp_mnoc

  iommus:
    maxItems: 30

  power-domains:
    items:
      - description: IFE0 GDSC - Image Front End, Global Distributed Switch Controller
      - description: IFE1 GDSC - Image Front End, Global Distributed Switch Controller
      - description: Titan GDSC - Titan ISP Block, Global Distributed Switch Controller
      - description: BPS GDSC - Bayer Processing Segment, Global Distributed Switch Controller
      - description: IPE0 GDSC - Image Processing Engine, Global Distributed Switch Controller
      - description: IPE1 GDSC - Image Processing Engine, Global Distributed Switch Controller

  power-domain-names:
    items:
      - const: ife0
      - const: ife1
      - const: top
      - const: bps
      - const: ipe0
      - const: ipe1

  vdda-phy-supply:
    description:
      Phandle to a regulator supply to the SoC analog part of the CSI PHYs.

  vdda-pll-supply:
    description:
      Phandle to a regulator supply to the PLL of the CSI PHYs.

  ports:
    $ref: /schemas/graph.yaml#/properties/ports

    description:
      CSI input ports.

    patternProperties:
      "^port@[0-3]$":
        $ref: /schemas/graph.yaml#/$defs/port-base
        unevaluatedProperties: false

        description:
          Input port for receiving CSI data from a CSIPHY.

        properties:
          endpoint:
            $ref: video-interfaces.yaml#
            unevaluatedProperties: false

            properties:
              data-lanes:
                minItems: 1
                maxItems: 4

            required:
              - data-lanes

required:
  - compatible
  - reg
  - reg-names
  - clocks
  - clock-names
  - interrupts
  - interrupt-names
  - interconnects
  - interconnect-names
  - iommus
  - power-domains
  - power-domain-names

additionalProperties: false

examples:
  - |
    #include <dt-bindings/clock/qcom,sm7150-camcc.h>
    #include <dt-bindings/clock/qcom,sm7150-gcc.h>
    #include <dt-bindings/interconnect/qcom,icc.h>
    #include <dt-bindings/interconnect/qcom,sm7150-rpmh.h>
    #include <dt-bindings/interrupt-controller/arm-gic.h>

    soc {
        #address-cells = <2>;
        #size-cells = <2>;

        camss: camss@ace0000 {
            compatible = "qcom,sm7150-camss";
            reg = <0 0x0ace0000 0 0x2000>,
                  <0 0x0ace2000 0 0x2000>,
                  <0 0x0ace4000 0 0x2000>,
                  <0 0x0ace6000 0 0x2000>,
                  <0 0x0acaf000 0 0x5200>,
                  <0 0x0acb6000 0 0x5200>,
                  <0 0x0acc4000 0 0x4000>,
                  <0 0x0ac6f000 0 0x3000>,
                  <0 0x0ac42000 0 0x6000>,
                  <0 0x0ac48000 0 0x1000>,
                  <0 0x0ac40000 0 0x1000>,
                  <0 0x0ac18000 0 0x3000>,
                  <0 0x0ac00000 0 0x6000>,
                  <0 0x0ac10000 0 0x8000>,
                  <0 0x0ac87000 0 0x3000>,
                  <0 0x0ac91000 0 0x3000>,
                  <0 0x0ac52000 0 0x4000>,
                  <0 0x0ac4e000 0 0x4000>,
                  <0 0x0ac6b000 0 0x0a00>;
            reg-names = "csiphy0",
                    "csiphy1",
                    "csiphy2",
                    "csiphy3",
                    "vfe0",
                    "vfe1",
                    "vfe_lite",
                    "bps",
                    "camnoc",
                    "cpas_cdm",
                    "cpas_top",
                    "ipc_csr",
                    "ipc_qgic",
                    "ipc_sierra",
                    "ipe0",
                    "ipe1",
                    "jpeg_dma",
                    "jpeg_enc",
                    "lrme";

            clocks = <&gcc GCC_CAMERA_HF_AXI_CLK>,
                 <&gcc GCC_CAMERA_SF_AXI_CLK>,
                 <&camcc CAMCC_CAMNOC_AXI_CLK>,
                 <&camcc CAMCC_CAMNOC_AXI_CLK_SRC>,
                 <&camcc CAMCC_CPAS_AHB_CLK>,
                 <&camcc CAMCC_CPHY_RX_CLK_SRC>,
                 <&camcc CAMCC_CSIPHY0_CLK>,
                 <&camcc CAMCC_CSI0PHYTIMER_CLK>,
                 <&camcc CAMCC_CSI0PHYTIMER_CLK_SRC>,
                 <&camcc CAMCC_CSIPHY1_CLK>,
                 <&camcc CAMCC_CSI1PHYTIMER_CLK>,
                 <&camcc CAMCC_CSI1PHYTIMER_CLK_SRC>,
                 <&camcc CAMCC_CSIPHY2_CLK>,
                 <&camcc CAMCC_CSI2PHYTIMER_CLK>,
                 <&camcc CAMCC_CSI2PHYTIMER_CLK_SRC>,
                 <&camcc CAMCC_CSIPHY3_CLK>,
                 <&camcc CAMCC_CSI3PHYTIMER_CLK>,
                 <&camcc CAMCC_CSI3PHYTIMER_CLK_SRC>,
                 <&camcc CAMCC_SLOW_AHB_CLK_SRC>,
                 <&camcc CAMCC_IFE_0_AXI_CLK>,
                 <&camcc CAMCC_IFE_0_CLK>,
                 <&camcc CAMCC_IFE_0_CLK_SRC>,
                 <&camcc CAMCC_IFE_0_CPHY_RX_CLK>,
                 <&camcc CAMCC_IFE_0_CSID_CLK>,
                 <&camcc CAMCC_IFE_0_CSID_CLK_SRC>,
                 <&camcc CAMCC_IFE_1_AXI_CLK>,
                 <&camcc CAMCC_IFE_1_CLK>,
                 <&camcc CAMCC_IFE_1_CLK_SRC>,
                 <&camcc CAMCC_IFE_1_CPHY_RX_CLK>,
                 <&camcc CAMCC_IFE_1_CSID_CLK>,
                 <&camcc CAMCC_IFE_1_CSID_CLK_SRC>,
                 <&camcc CAMCC_IFE_LITE_CLK>,
                 <&camcc CAMCC_IFE_LITE_CLK_SRC>,
                 <&camcc CAMCC_IFE_LITE_CPHY_RX_CLK>,
                 <&camcc CAMCC_IFE_LITE_CSID_CLK>,
                 <&camcc CAMCC_IFE_LITE_CSID_CLK_SRC>,
                 <&camcc CAMCC_BPS_CLK>,
                 <&camcc CAMCC_BPS_CLK_SRC>,
                 <&camcc CAMCC_BPS_AHB_CLK>,
                 <&camcc CAMCC_BPS_AXI_CLK>,
                 <&camcc CAMCC_BPS_AREG_CLK>,
                 <&camcc CAMCC_ICP_CLK>,
                 <&camcc CAMCC_ICP_CLK_SRC>,
                 <&camcc CAMCC_ICP_AHB_CLK>,
                 <&camcc CAMCC_IPE_0_CLK>,
                 <&camcc CAMCC_IPE_0_CLK_SRC>,
                 <&camcc CAMCC_IPE_0_AHB_CLK>,
                 <&camcc CAMCC_IPE_0_AREG_CLK>,
                 <&camcc CAMCC_IPE_0_AXI_CLK>,
                 <&camcc CAMCC_IPE_1_CLK>,
                 <&camcc CAMCC_IPE_1_AHB_CLK>,
                 <&camcc CAMCC_IPE_1_AREG_CLK>,
                 <&camcc CAMCC_IPE_1_AXI_CLK>,
                 <&camcc CAMCC_JPEG_CLK>,
                 <&camcc CAMCC_JPEG_CLK_SRC>,
                 <&camcc CAMCC_LRME_CLK>,
                 <&camcc CAMCC_LRME_CLK_SRC>;
            clock-names = "cam_hf_axi",
                      "cam_sf_axi",
                      "camnoc_axi",
                      "camnoc_axi_src",
                      "cpas_ahb",
                      "cphy_rx_src",
                      "csiphy0",
                      "csiphy0_timer",
                      "csiphy0_timer_src",
                      "csiphy1",
                      "csiphy1_timer",
                      "csiphy1_timer_src",
                      "csiphy2",
                      "csiphy2_timer",
                      "csiphy2_timer_src",
                      "csiphy3",
                      "csiphy3_timer",
                      "csiphy3_timer_src",
                      "slow_ahb_src",
                      "vfe0_axi",
                      "vfe0",
                      "vfe0_src",
                      "vfe0_cphy_rx",
                      "vfe0_csid",
                      "vfe0_csid_src",
                      "vfe1_axi",
                      "vfe1",
                      "vfe1_src",
                      "vfe1_cphy_rx",
                      "vfe1_csid",
                      "vfe1_csid_src",
                      "vfe_lite",
                      "vfe_lite_src",
                      "vfe_lite_cphy_rx",
                      "vfe_lite_csid",
                      "vfe_lite_csid_src",
                      "bps",
                      "bps_src",
                      "bps_ahb",
                      "bps_axi",
                      "bps_areg",
                      "icp",
                      "icp_src",
                      "icp_ahb",
                      "ipe0",
                      "ipe0_src",
                      "ipe0_ahb",
                      "ipe0_areg",
                      "ipe0_axi",
                      "ipe1",
                      "ipe1_ahb",
                      "ipe1_areg",
                      "ipe1_axi",
                      "jpeg",
                      "jpeg_src",
                      "lrme",
                      "lrme_src";

            interrupts = <GIC_SPI 477 IRQ_TYPE_EDGE_RISING>,
                     <GIC_SPI 478 IRQ_TYPE_EDGE_RISING>,
                     <GIC_SPI 479 IRQ_TYPE_EDGE_RISING>,
                     <GIC_SPI 607 IRQ_TYPE_EDGE_RISING>,
                     <GIC_SPI 464 IRQ_TYPE_EDGE_RISING>,
                     <GIC_SPI 466 IRQ_TYPE_EDGE_RISING>,
                     <GIC_SPI 438 IRQ_TYPE_EDGE_RISING>,
                     <GIC_SPI 465 IRQ_TYPE_EDGE_RISING>,
                     <GIC_SPI 467 IRQ_TYPE_EDGE_RISING>,
                     <GIC_SPI 434 IRQ_TYPE_EDGE_RISING>,
                     <GIC_SPI 459 IRQ_TYPE_EDGE_RISING>,
                     <GIC_SPI 468 IRQ_TYPE_EDGE_RISING>,
                     <GIC_SPI 463 IRQ_TYPE_EDGE_RISING>,
                     <GIC_SPI 475 IRQ_TYPE_EDGE_RISING>,
                     <GIC_SPI 474 IRQ_TYPE_EDGE_RISING>,
                     <GIC_SPI 476 IRQ_TYPE_EDGE_RISING>;
            interrupt-names = "csiphy0",
                      "csiphy1",
                      "csiphy2",
                      "csiphy3",
                      "csid0",
                      "csid1",
                      "csid_lite",
                      "vfe0",
                      "vfe1",
                      "vfe_lite",
                      "camnoc",
                      "cdm",
                      "icp",
                      "jpeg_dma",
                      "jpeg_enc",
                      "lrme";

            power-domains = <&camcc IFE_0_GDSC>,
                    <&camcc IFE_1_GDSC>,
                    <&camcc TITAN_TOP_GDSC>,
                    <&camcc BPS_GDSC>,
                    <&camcc IPE_0_GDSC>,
                    <&camcc IPE_1_GDSC>;
            power-domain-names = "ife0",
                         "ife1",
                         "top",
                         "bps",
                         "ipe0",
                         "ipe1";

            iommus = <&apps_smmu 0x820 0x440>,
                 <&apps_smmu 0x880 0x460>,
                 <&apps_smmu 0x900 0x460>,
                 <&apps_smmu 0x8a0 0x460>,
                 <&apps_smmu 0x8c0 0x460>,
                 <&apps_smmu 0x920 0x460>,
                 <&apps_smmu 0x940 0x460>,
                 <&apps_smmu 0xc20 0x440>,
                 <&apps_smmu 0xc80 0x460>,
                 <&apps_smmu 0xca0 0x460>,
                 <&apps_smmu 0xcc0 0x460>,
                 <&apps_smmu 0xd00 0x460>,
                 <&apps_smmu 0xd20 0x460>,
                 <&apps_smmu 0xd40 0x460>,
                 <&apps_smmu 0x1000 0x0>,
                 <&apps_smmu 0x1042 0x0>,
                 <&apps_smmu 0x1180 0x0>,
                 <&apps_smmu 0x11a0 0x0>,
                 <&apps_smmu 0x11c0 0x0>,
                 <&apps_smmu 0x11e0 0x0>,
                 <&apps_smmu 0x1200 0x0>,
                 <&apps_smmu 0x1220 0x0>,
                 <&apps_smmu 0x1240 0x0>,
                 <&apps_smmu 0x1260 0x0>,
                 <&apps_smmu 0x1280 0x20>,
                 <&apps_smmu 0x12a0 0x20>,
                 <&apps_smmu 0x12c0 0x20>,
                 <&apps_smmu 0x12e0 0x20>,
                 <&apps_smmu 0x1300 0x60>,
                 <&apps_smmu 0x1320 0x60>;

            interconnects = <&gem_noc MASTER_AMPSS_M0 QCOM_ICC_TAG_ACTIVE_ONLY
                     &config_noc SLAVE_CAMERA_CFG QCOM_ICC_TAG_ACTIVE_ONLY>,
                    <&mmss_noc MASTER_CAMNOC_HF0 QCOM_ICC_TAG_ALWAYS
                     &mc_virt SLAVE_EBI_CH0 QCOM_ICC_TAG_ALWAYS>,
                    <&mmss_noc MASTER_CAMNOC_SF QCOM_ICC_TAG_ALWAYS
                     &mc_virt SLAVE_EBI_CH0 QCOM_ICC_TAG_ALWAYS>,
                    <&mmss_noc MASTER_CAMNOC_RT QCOM_ICC_TAG_ALWAYS
                     &mc_virt SLAVE_EBI_CH0 QCOM_ICC_TAG_ALWAYS>;
            interconnect-names = "cam_ahb",
                         "cam_hf_0_mnoc",
                         "cam_sf_0_mnoc",
                         "cam_sf_icp_mnoc";


            ports {
                #address-cells = <1>;
                #size-cells = <0>;

                port@0 {
                    reg = <0>;
                };

                port@1 {
                    reg = <1>;
                };

                port@2 {
                    reg = <2>;
                };

                port@3 {
                    reg = <3>;
                };
            };
        };
    };
```
