## arch/arm64/configs/sunfish_defconfig
```kconfig
# Sunfish-specific defconfig - starts from sm7150.config fragment
# Include the base sm7150 fragment via Kconfig
CONFIG_LOCALVERSION="-sm7150"
# CONFIG_LOCALVERSION_AUTO is not set

# SM7150 SoC
CONFIG_INTERCONNECT_QCOM_OSM_L3=y
CONFIG_INTERCONNECT_QCOM_SM7150=y
CONFIG_NR_CPUS=8
CONFIG_NODES_SHIFT=1
CONFIG_PINCTRL_SM7150=y
CONFIG_PINCTRL_LPASS_LPI=y
CONFIG_PINCTRL_SM7150_LPASS_LPI=y
CONFIG_SC_GPUCC_7180=y
CONFIG_SM_CAMCC_7150=y
CONFIG_SM_DISPCC_7150=y
CONFIG_SM_GCC_7150=y
CONFIG_SM_VIDEOCC_7150=y

CONFIG_GPIO_SHARED_PROXY=y

CONFIG_RFKILL=m
CONFIG_CFG80211=y
CONFIG_MAC80211=y
CONFIG_ATH10K=y

# Qualcomm SoC drivers
CONFIG_QCOM_LLCC=y
CONFIG_QCOM_OCMEM=y
CONFIG_QCOM_RMTFS_MEM=y
CONFIG_QCOM_SOCINFO=y
CONFIG_QCOM_APR=y

# Qualcomm TZ memory
CONFIG_QCOM_TZMEM_MODE_SHMBRIDGE=y

# SPMI
CONFIG_QCOM_SPMI_VADC=y

# Console ramoops & USB debug
CONFIG_PSTORE=y
CONFIG_PSTORE_CONSOLE=y
CONFIG_PSTORE_PMSG=y
CONFIG_PSTORE_RAM=y
CONFIG_U_SERIAL_CONSOLE=y
CONFIG_USB_SERIAL_SIMPLE=m

# Remoteproc
CONFIG_SLIMBUS=y
CONFIG_SLIM_QCOM_CTRL=y
CONFIG_SLIM_QCOM_NGD_CTRL=y
CONFIG_REMOTEPROC_CDEV=y
CONFIG_QCOM_PIL_INFO=y

# Graphics
CONFIG_FB_SIMPLE=y
CONFIG_DRM=y
CONFIG_DRM_DISPLAY_HELPER=y
CONFIG_DRM_MSM=y
CONFIG_BACKLIGHT_CLASS_DEVICE=y
CONFIG_BACKLIGHT_QCOM_WLED=y

# Power management
CONFIG_PM_AUTOSLEEP=y
CONFIG_PM_WAKELOCKS=y

# I2C system bus drivers
CONFIG_I2C_QCOM_GENI=y

# SPI Master Controller Drivers
CONFIG_SPI_QCOM_GENI=y

# DMA Devices
CONFIG_QCOM_GPI_DMA=y

# Generic Driver Options
CONFIG_UEVENT_HELPER=y

# MMC/SD/SDIO Host Controller Drivers
CONFIG_SCSI_UFS_QCOM=y

# PHY Subsystem
CONFIG_PHY_QCOM_QMP=y
CONFIG_PHY_QCOM_QMP_COMBO=y
CONFIG_PHY_QCOM_QMP_UFS=y
CONFIG_PHY_QCOM_QMP_USB=y
CONFIG_PHY_QCOM_QUSB2=y
CONFIG_PHY_QCOM_USB_HS=y
CONFIG_PHY_QCOM_USB_SNPS_FEMTO_V2=y
CONFIG_PHY_QCOM_USB_SS=y

# USB
CONFIG_USB_ANNOUNCE_NEW_DEVICES=y
CONFIG_USB_CONFIGFS=m
CONFIG_USB_CONFIGFS_F_HID=y
CONFIG_USB_ETH_RNDIS=y
CONFIG_USB_USBNET=y
CONFIG_USB_STORAGE=m

# USB Type-C 
CONFIG_TYPEC=y
CONFIG_TYPEC_TCPCI=y
CONFIG_TYPEC_TCPM=y
CONFIG_TYPEC_QCOM_PMIC=y

# REGULATOR
CONFIG_REGULATOR_QCOM_REFGEN=y
CONFIG_REGULATOR_QCOM_USB_VBUS=y

# Google Pixel 4a (Sunfish)
CONFIG_DRM_PANEL_SAMSUNG_AMS581VF01=y
CONFIG_SND_SOC_RT5514=m
CONFIG_SND_SOC_RT5514_SPI=m
CONFIG_SND_SOC_CS35L41_I2C=m

# Common for SM7150 devices
CONFIG_NFC_SHDLC=y
CONFIG_NFC_NXP_NCI=m
CONFIG_NFC_NXP_NCI=m
CONFIG_TOUCHSCREEN_GOODIX_GTX8=y
CONFIG_TOUCHSCREEN_ST_FTS_V521=y
CONFIG_INPUT_AW8695_HAPTICS=m
CONFIG_BATTERY_QCOM_QG=m
CONFIG_TYPEC_MUX_FSA4480=y
CONFIG_RTC_DRV_PM8XXX=y
CONFIG_CHARGER_QCOM_SMB2=m
```

## drivers/media/platform/qcom/camss/Kconfig
```kconfig
config VIDEO_QCOM_CAMSS
	tristate "Qualcomm V4L2 Camera Subsystem driver"
	depends on V4L_PLATFORM_DRIVERS
	depends on VIDEO_DEV
	depends on (ARCH_QCOM && IOMMU_DMA) || COMPILE_TEST
	select MEDIA_CONTROLLER
	select VIDEO_V4L2_SUBDEV_API
	select VIDEOBUF2_DMA_SG
	select VIDEOBUF2_VMALLOC
	select V4L2_FWNODE

config VIDEO_QCOM_CAMSS_KUNIT_TEST
	bool "KUnit tests for the Qualcomm CAMSS lifecycle" if !KUNIT_ALL_TESTS
	depends on VIDEO_QCOM_CAMSS=y && KUNIT=y
	default KUNIT_ALL_TESTS
	help
	  Tests for the Titan 170 pixel path lifecycle and the video node
	  format and start unwind helpers, against faked hardware.
```
