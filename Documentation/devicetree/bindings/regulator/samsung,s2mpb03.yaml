## Documentation/devicetree/bindings/regulator/samsung,s2mpb03.yaml
```yaml
# SPDX-License-Identifier: GPL-2.0-only OR BSD-2-Clause
%YAML 1.2
---
$id: http://devicetree.org/schemas/regulator/samsung,s2mpb03.yaml#
$schema: http://devicetree.org/meta-schemas/core.yaml#

title: Samsung S2MPB03 camera PMIC

maintainers:
  - Miroslav Mráz <miroslav.mraz@techmania.cz>

description:
  The Samsung S2MPB03 is a camera power management IC providing seven LDO
  regulators controlled over I2C. It is found on boards such as the Samsung
  Galaxy A52 (SM7125).

properties:
  compatible:
    const: samsung,s2mpb03

  reg:
    maxItems: 1

  regulators:
    type: object
    additionalProperties: false
    description:
      List of the seven LDO regulators, named after their hardware
      counterparts ldo1 to ldo7.

    patternProperties:
      "^ldo[1-7]$":
        type: object
        $ref: regulator.yaml#
        unevaluatedProperties: false

required:
  - compatible
  - reg
  - regulators

additionalProperties: false

examples:
  - |
    i2c {
        #address-cells = <1>;
        #size-cells = <0>;

        pmic@56 {
            compatible = "samsung,s2mpb03";
            reg = <0x56>;

            regulators {
                ldo1 {
                    regulator-min-microvolt = <1050000>;
                    regulator-max-microvolt = <1050000>;
                };

                ldo3 {
                    regulator-min-microvolt = <1800000>;
                    regulator-max-microvolt = <1800000>;
                };
            };
        };
    };
...
```

## Documentation/devicetree/bindings/soc/mediatek/mediatek,mt6797-a72-power.yaml
```yaml
# SPDX-License-Identifier: (GPL-2.0 OR BSD-2-Clause)
%YAML 1.2
---
$id: http://devicetree.org/schemas/soc/mediatek/mediatek,mt6797-a72-power.yaml#
$schema: http://devicetree.org/meta-schemas/core.yaml#

title: MediaTek MT6797 Cortex-A72 cluster power-on sequencer

maintainers:
  - Miroslav Mraz <miroslav.mraz@techmania.cz>

description:
  The MediaTek MT6797 Cortex-A72 ("big") cluster must be powered up before
  PSCI CPU_ON of cpu@200/201. The stock firmware does not do this, so a
  pre-CPU_ON sequence (SPM power request and external-buck isolation, the
  DA9214 buck B supply, the iDVFS SRAM LDO through a secure SIP call, and the
  MP2 synchronous DCM) is run from the kernel when the first Cortex-A72 core is
  brought online. The register window described here is the MCUCFG2 / iDVFS
  block (MP2 DCM and the iDVFS PLL control word).

properties:
  compatible:
    const: mediatek,mt6797-a72-power

  reg:
    maxItems: 1
    description: MCUCFG2 / iDVFS register window.

  mediatek,spm:
    $ref: /schemas/types.yaml#/definitions/phandle
    description: Phandle to the SPM (System Power Manager) syscon.

  resets:
    maxItems: 1
    description: The TOPRGU PWRAP-SPI-CTL software reset line.

  reset-names:
    items:
      - const: pwrap

  vproc-supply:
    description: The Cortex-A72 cluster supply (DA9214 buck B / vproc-big).

required:
  - compatible
  - reg
  - mediatek,spm
  - resets
  - reset-names
  - vproc-supply

additionalProperties: false

examples:
  - |
    #include <dt-bindings/reset/mediatek,mt6797-wdt.h>

    power-sequencer@10222000 {
        compatible = "mediatek,mt6797-a72-power";
        reg = <0x10222000 0x1000>;
        mediatek,spm = <&spm>;
        resets = <&watchdog MT6797_TOPRGU_PWRAP_SPI_CTL_RST>;
        reset-names = "pwrap";
        vproc-supply = <&da9214_buckb>;
    };
```

## Documentation/devicetree/bindings/soc/mediatek/mediatek,mt6797-consys.yaml
```yaml
# SPDX-License-Identifier: (GPL-2.0-only OR BSD-2-Clause)
%YAML 1.2
---
$id: http://devicetree.org/schemas/soc/mediatek/mediatek,mt6797-consys.yaml#
$schema: http://devicetree.org/meta-schemas/core.yaml#

title: MediaTek MT6797 connectivity subsystem (CONSYS)

maintainers:
  - Miroslav Mraz <miroslav.mraz@techmania.cz>

description: |
  The MT6797 integrates a Wi-Fi/Bluetooth combo (MT6631 RF) as the CONSYS
  subsystem. This node describes the CONSYS MCU control block, the VCN analog
  power rails, the connectivity MCU reset line on the TOPRGU watchdog, the CONN
  power domain and the no-map firmware memory shared with Wi-Fi. The BTIF
  transport is a separate IP (see mediatek,mt6797-btif).

properties:
  compatible:
    const: mediatek,mt6797-consys

  reg:
    maxItems: 1
    description: CONSYS MCU control block (chip ID and MCU ACR registers).

  reg-names:
    const: conn-mcu

  interrupts:
    items:
      - description: BGF (connectivity) external interrupt.
      - description: Connectivity watchdog external interrupt.

  interrupt-names:
    items:
      - const: bgf
      - const: wdt

  vcn18-supply:
    description: Common 1.8 V connectivity supply.

  vcn28-supply:
    description: Common 2.8 V connectivity supply.

  vcn33-bt-supply:
    description: |
      Bluetooth 3.3 V PA supply. On MT6351 this is the same physical rail as
      vcn33-wifi (one LDO), consumed independently by the BT and Wi-Fi paths.

  vcn33-wifi-supply:
    description: Wi-Fi 3.3 V supply (see vcn33-bt-supply).

  resets:
    maxItems: 1

  reset-names:
    const: con-mcu

  memory-region:
    maxItems: 1
    description: No-map firmware memory reservation shared with Wi-Fi.

  power-domains:
    maxItems: 1
    description: CONN power domain.

required:
  - compatible
  - reg
  - reg-names
  - interrupts
  - interrupt-names
  - vcn18-supply
  - vcn28-supply
  - memory-region
  - resets
  - reset-names

additionalProperties: false

examples:
  - |
    #include <dt-bindings/interrupt-controller/arm-gic.h>
    #include <dt-bindings/interrupt-controller/irq.h>
    #include <dt-bindings/power/mt6797-power.h>
    #include <dt-bindings/reset/mediatek,mt6797-wdt.h>

    consys@18070000 {
        compatible = "mediatek,mt6797-consys";
        reg = <0x18070000 0x200>;
        reg-names = "conn-mcu";
        interrupts = <GIC_SPI 284 IRQ_TYPE_LEVEL_LOW>,
                     <GIC_SPI 285 IRQ_TYPE_LEVEL_LOW>;
        interrupt-names = "bgf", "wdt";
        vcn18-supply = <&mt6351_vcn18_reg>;
        vcn28-supply = <&mt6351_vcn28_reg>;
        vcn33-bt-supply = <&mt6351_vcn33_reg>;
        vcn33-wifi-supply = <&mt6351_vcn33_reg>;
        resets = <&watchdog MT6797_TOPRGU_CONMCU_SW_RST>;
        reset-names = "con-mcu";
        memory-region = <&consys_reserved>;
        power-domains = <&scpsys MT6797_POWER_DOMAIN_CONN>;
    };
```

## Documentation/devicetree/bindings/soc/qcom/qcom,smp2p-sleepstate.yaml
```yaml
# SPDX-License-Identifier: GPL-2.0-only OR BSD-2-Clause
%YAML 1.2
---
$id: http://devicetree.org/schemas/soc/qcom/qcom,smp2p-sleepstate.yaml#
$schema: http://devicetree.org/meta-schemas/core.yaml#

title: Qualcomm SMP2P AP sleep state notifier

maintainers:
  - Miroslav Mráz <miroslav.mraz@techmania.cz>

description:
  Publishes whether the application processor is suspended on the "sleepstate"
  SMP2P entry of an edge (typically the ADSP). The sensor DSP watches this bit
  to control its suspend/resume behaviour. The remote can in turn raise its
  "sleepstate_see" entry to request that the AP stay awake briefly, which is
  delivered to this device as an interrupt.

properties:
  compatible:
    const: qcom,smp2p-sleepstate

  qcom,smem-states:
    $ref: /schemas/types.yaml#/definitions/phandle-array
    items:
      - items:
          - description: phandle to the outbound "sleepstate" SMP2P entry
          - description: the AP-awake bit within that entry
    description: The outgoing SMP2P entry carrying the AP sleep state.

  interrupts:
    maxItems: 1
    description: Incoming interrupt from the remote "sleepstate_see" entry.

required:
  - compatible
  - qcom,smem-states
  - interrupts

additionalProperties: false

examples:
  - |
    #include <dt-bindings/interrupt-controller/irq.h>

    smp2p-sleepstate {
        compatible = "qcom,smp2p-sleepstate";
        qcom,smem-states = <&sleepstate_smp2p_out 12>;
        interrupts-extended = <&sleepstate_smp2p_in 0 IRQ_TYPE_EDGE_RISING>;
    };
```

## Documentation/devicetree/bindings/sound/mediatek,mt6797-afe-pcm.yaml
```yaml
# SPDX-License-Identifier: (GPL-2.0-only OR BSD-2-Clause)
%YAML 1.2
---
$id: http://devicetree.org/schemas/sound/mediatek,mt6797-afe-pcm.yaml#
$schema: http://devicetree.org/meta-schemas/core.yaml#

title: MediaTek MT6797 Audio Front End PCM controller

maintainers:
  - KaiChieh Chuang <kaichieh.chuang@mediatek.com>

properties:
  compatible:
    const: mediatek,mt6797-audio

  reg:
    maxItems: 1

  interrupts:
    maxItems: 1

  power-domains:
    maxItems: 1

  clocks:
    minItems: 8
    maxItems: 8

  clock-names:
    items:
      - const: infra_sys_audio_clk
      - const: infra_sys_audio_26m
      - const: mtkaif_26m_clk
      - const: top_mux_audio
      - const: top_mux_aud_intbus
      - const: top_sys_pll3_d4
      - const: top_sys_pll1_d4
      - const: top_clk26m_clk

required:
  - compatible
  - reg
  - interrupts
  - power-domains
  - clocks
  - clock-names

additionalProperties: false

examples:
  - |
    #include <dt-bindings/clock/mt6797-clk.h>
    #include <dt-bindings/interrupt-controller/arm-gic.h>
    #include <dt-bindings/interrupt-controller/irq.h>
    #include <dt-bindings/power/mt6797-power.h>

    soc {
        #address-cells = <2>;
        #size-cells = <2>;

        audio-controller@11220000 {
            compatible = "mediatek,mt6797-audio";
            reg = <0 0x11220000 0 0x1000>;
            interrupts = <GIC_SPI 151 IRQ_TYPE_LEVEL_LOW>;
            power-domains = <&scpsys MT6797_POWER_DOMAIN_AUDIO>;
            clocks = <&infrasys CLK_INFRA_AUDIO>,
                     <&infrasys CLK_INFRA_AUDIO_26M>,
                     <&infrasys CLK_INFRA_AUDIO_26M_PAD_TOP>,
                     <&topckgen CLK_TOP_MUX_AUDIO>,
                     <&topckgen CLK_TOP_MUX_AUD_INTBUS>,
                     <&topckgen CLK_TOP_SYSPLL3_D4>,
                     <&topckgen CLK_TOP_SYSPLL1_D4>,
                     <&clk26m>;
            clock-names = "infra_sys_audio_clk",
                          "infra_sys_audio_26m",
                          "mtkaif_26m_clk",
                          "top_mux_audio",
                          "top_mux_aud_intbus",
                          "top_sys_pll3_d4",
                          "top_sys_pll1_d4",
                          "top_clk26m_clk";
        };
    };
```

## Documentation/devicetree/bindings/sound/mediatek,mt6797-mt6351.yaml
```yaml
# SPDX-License-Identifier: (GPL-2.0-only OR BSD-2-Clause)
%YAML 1.2
---
$id: http://devicetree.org/schemas/sound/mediatek,mt6797-mt6351.yaml#
$schema: http://devicetree.org/meta-schemas/core.yaml#

title: MediaTek MT6797 with MT6351 CODEC sound card

maintainers:
  - Miroslav Mraz <miroslav.mraz@techmania.cz>

properties:
  compatible:
    const: mediatek,mt6797-mt6351-sound

  mediatek,platform:
    $ref: /schemas/types.yaml#/definitions/phandle
    description: The phandle of the MT6797 AFE platform.

  mediatek,audio-codec:
    $ref: /schemas/types.yaml#/definitions/phandle
    description: The phandle of the MT6351 audio codec.

  mediatek,accdet:
    $ref: /schemas/types.yaml#/definitions/phandle
    description:
      The phandle of the MT6351 ACCDET node, to enable headset plug and
      button detection through a headset jack.

  aux-devs:
    $ref: /schemas/types.yaml#/definitions/phandle-array
    description:
      List of phandles of auxiliary devices, such as analog speaker
      amplifiers fed by the MT6351 outputs.
    items:
      maxItems: 1

  audio-routing:
    $ref: /schemas/types.yaml#/definitions/non-unique-string-array
    description:
      A list of the connections between audio components. Each entry is a
      pair of strings, the first being the connection's sink, the second
      being the connection's source.

required:
  - compatible
  - mediatek,platform
  - mediatek,audio-codec

additionalProperties: false

examples:
  - |
    sound {
        compatible = "mediatek,mt6797-mt6351-sound";
        mediatek,platform = <&afe>;
        mediatek,audio-codec = <&mt6351_codec>;
        mediatek,accdet = <&accdet>;
        aux-devs = <&speaker_amp>;
        audio-routing = "Speaker Amp IN", "LINEOUT L";
    };
```

## Documentation/devicetree/bindings/sound/mt6797-mt6351.txt
```
MT6797 with MT6351 CODEC

Required properties:
- compatible: "mediatek,mt6797-mt6351-sound"
- mediatek,platform: the phandle of MT6797 ASoC platform
- mediatek,audio-codec: the phandles of MT6351 codec

Optional properties:
- mediatek,accdet: the phandle of the MT6351 ACCDET node, to enable
  headset plug and button detection through a headset jack.

Example:

	sound {
		compatible = "mediatek,mt6797-mt6351-sound";
		mediatek,audio-codec = <&mt6351_snd>;
		mediatek,platform = <&afe>;
		mediatek,accdet = <&accdet>;
	};
```

## Documentation/devicetree/bindings/usb/siliconmitus,sm5714-muic.yaml
```yaml
# SPDX-License-Identifier: GPL-2.0-only OR BSD-2-Clause
%YAML 1.2
---
$id: http://devicetree.org/schemas/usb/siliconmitus,sm5714-muic.yaml#
$schema: http://devicetree.org/meta-schemas/core.yaml#

title: Silicon Mitus SM5714 MUIC USB data switch

maintainers:
  - Miroslav Mráz <miroslav.mraz@techmania.cz>

description:
  The SM5714 is a combo PMIC integrating a charger, a fuel gauge and a
  Type-C/USB block. This binding describes the MUIC (Micro USB Interface
  Controller) block, which is exposed on its own I2C address and contains the
  analog switch for the USB D+/D- data lines. It is used as a Type-C mode
  switch, driven by the Type-C CC detection block through the connector graph,
  to force the data lines onto the USB path while operating as a host.

properties:
  compatible:
    const: siliconmitus,sm5714-muic

  reg:
    maxItems: 1

  mode-switch: true

  port:
    $ref: /schemas/graph.yaml#/properties/port
    description:
      A port node to link the MUIC to the SM5714 Type-C CC detection block,
      which drives the USB data path switching.

required:
  - compatible
  - reg
  - mode-switch
  - port

additionalProperties: false

examples:
  - |
    i2c {
        #address-cells = <1>;
        #size-cells = <0>;

        typec-mux@25 {
            compatible = "siliconmitus,sm5714-muic";
            reg = <0x25>;

            mode-switch;

            port {
                sm5714_muic_ept: endpoint {
                    remote-endpoint = <&sm5714_cc_ept>;
                };
            };
        };
    };
...
```
